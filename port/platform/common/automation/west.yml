## port/platform/zephyr/dts/bindings/u-blox,ubxlib-device-short-range.yaml
```yaml
# The device tree bindings for a ubxlib short-range device;
# basically uDeviceCfgShortRange_t (see /common/device/api/device.h)
# but in .yaml form for Zephyr.

description: "ubxlib short-range (i.e. Wi-Fi or BLE) device configuration."

compatible: "u-blox,ubxlib-device-short-range"

properties:
# transport-type; note that this is not a required field since it may be absent in the open CPU case
    transport-type:
        type: string
        description: "The node label STRING for the transport that the short-range module is connected on, e.g. \"uart0\", no ampersand, no angle brackets and not an alias; make sure that &uart0, or whatever, is enabled in your device tree of course."
# baudRate for UART
    uart-baud-rate:
        type: int
        default: 115200
        description: "The baud-rate that the UART is running at, if not the default of 115200."
# moduleType, chosen from /common/short-range/api/u_short_range_module_type.h
    module-type:
        type: string
        default: "U_SHORT_RANGE_MODULE_TYPE_ANY"
        description: "The short-range module type."
        enum:
            - "U_SHORT_RANGE_MODULE_TYPE_INTERNAL"
            - "U_SHORT_RANGE_MODULE_TYPE_ANNA_B1"
            - "U_SHORT_RANGE_MODULE_TYPE_NINA_B1"
            - "U_SHORT_RANGE_MODULE_TYPE_NINA_B2"
            - "U_SHORT_RANGE_MODULE_TYPE_NINA_B3"
            - "U_SHORT_RANGE_MODULE_TYPE_NINA_B4"
            - "U_SHORT_RANGE_MODULE_TYPE_NINA_W13"
            - "U_SHORT_RANGE_MODULE_TYPE_NINA_W15"
            - "U_SHORT_RANGE_MODULE_TYPE_ODIN_W2"
            - "U_SHORT_RANGE_MODULE_TYPE_NORA_W36"
            # Add any new module types here, before U_SHORT_RANGE_MODULE_TYPE_ANY
            - "U_SHORT_RANGE_MODULE_TYPE_ANY"
# the open CPU variant
    open-cpu:
        type: boolean
        description: "Specify this flag if this is a short-range configuration for open CPU (i.e. this code is running _inside_ the short-range module that it is using the BLE/Wi-Fi of, rather than using an external short-range module via the uConnectExpress AT interface)."
# Associated network configurations
    network:
        type: phandles
        description: "Network configuration(s) associated with this device; two may be needed if both BLE and Wi-Fi networks are in use."
```

## port/platform/zephyr/dts/bindings/u-blox,ubxlib-network-ble.yaml
```yaml
# The device tree bindings that describe a ubxlib network
# configuration for a BLE module; basically uNetworkCfgBle_t
# (see /common/network/api/u_network_config_ble.h) but
# in .yaml form for Zephyr.

description: "ubxlib network configuration for BLE."

compatible: "u-blox,ubxlib-network-ble"

properties:
    do-not-set-network-type:
       type: int
       default: 1
       description: "A hidden property: the application should _not_ set this, just allow it to be the default for a BLE network (matches U_NETWORK_TYPE_BLE)."
    role:
        type: string
        description: "The role for the device; peripheral, central or both."
        required: true
        enum:
            - "U_BLE_CFG_ROLE_DISABLED"
            - "U_BLE_CFG_ROLE_CENTRAL"
            - "U_BLE_CFG_ROLE_PERIPHERAL"
            - "U_BLE_CFG_ROLE_CENTRAL_AND_PERIPHERAL"
    enable-sps-server:
        type: boolean
        description: "Specify this if SPS server is to be enabled."
```

## port/platform/zephyr/dts/bindings/u-blox,ubxlib-network-cellular -uart-ppp.yaml
```yaml
# The device tree bindings that describe the UART configuration
# of a [separate to the AT interface] PPP connection for cellular;
# uDeviceCfgUart_t (see /common/device/api/u_device.h) but in .yaml
# form, ONLY USED if the interface used for PPP is not the
# same physical interface as the one used for AT.
#
# Note: this is NOTHING TO DO WITH uart-ppp; uart-ppp is a virtual
# thing that Zephyr needs to make a PPP connection, this is the
# physical PPP connection to the module

description: "ubxlib UART configuration for PPP with cellular."

compatible: "u-blox,ubxlib-network-cellular-uart-ppp"

properties:
# transportType
    transport-type:
        type: string
        required: true
        description: "The node label STRING for the transport that the cellular module is connected on, e.g. \"uart0\", no ampersand, no angle brackets and not an alias; make sure that &uart0, or whatever, is enabled in your device tree of course."
# baudRate for UART
    uart-baud-rate:
        type: int
        default: 115200
        description: "The baud-rate that the UART is running at, if not the default of 115200."
```

## port/platform/zephyr/dts/bindings/u-blox,ubxlib-network-cellular.yaml
```yaml
# The device tree bindings that describe a ubxlib network
# configuration for cellular; basically uNetworkCfgCell_t
# (see /common/network/api/u_network_config_cell.h) but
# in .yaml form for Zephyr.

description: "ubxlib network configuration for cellular."

compatible: "u-blox,ubxlib-network-cellular"

properties:
# Hidden property: network type
    do-not-set-network-type:
       type: int
       default: 2
       description: "A hidden property: the application should _not_ set this, just allow it to be the default for a cellular network (matches U_NETWORK_TYPE_CELL)."
# APN string
    apn:
        type: string
        description: "The APN for your network; only specify this if your service provider _requires_ you to do so.  If not specified a database look-up will be used, specify \"\" to NOT do a database look-up."
# timeout
    timeout-seconds:
        type: int
        default: 1800
        description: "The timeout when connecting to the network in seconds; this is a LOOONG time in case you are using an NB1 network, where initial search can take many many minutes; if you are NOT using an NB1 network specify a shorter time (e.g. 240 seconds), or alternatively in your code you may specify a timeout callback, see /common/network/api/u_network_config_cell.h."
# username
    username:
        type: string
        description: "ONLY REQUIRED if you must use a user name and password with the APN provided to you by your service provider."
# password
    password:
        type: string
        description: "ONLY REQUIRED if you must use a user name and password with the APN provided to you by your service provider."
# authentication mode
    authentication-mode:
        type: int
        default: 0
        description: "use 1 for PAP, 2 for CHAP, 3 for automatic (where supported), ONLY REQUIRED if you must give a user name and password with the APN provided to you by your service provider and your cellular module does NOT support figuring out the authentication mode automatically; there is no harm in populating this field even if your module _does_ support figuring out the authentication mode automatically."
# MCC/MNC string
    mccmnc:
        type: string
        description: "ONLY REQUIRED if you want to connect to a specific cellular network (e.g. \"23410\") rather than letting the module just choose the best one."
```

## port/platform/zephyr/dts/bindings/u-blox,ubxlib-network-gnss.yaml
```yaml
# The device tree bindings that describe a ubxlib network
# configuration for GNSS; basically uNetworkCfgGnss_t
# (see /common/network/api/u_network_config_gnss.h) but
# in .yaml form for Zephyr.

description: "ubxlib network configuration for GNSS."

compatible: "u-blox,ubxlib-network-gnss"

properties:
# Hidden property: network type
    do-not-set-network-type:
       type: int
       default: 4
       description: "A hidden property: the application should _not_ set this, just allow it to be the default for a GNSS network (matches U_NETWORK_TYPE_GNSS)."
# moduleType, chosen from /gnss/api/u_gnss_module_type.h
# IMPORTANT: if you update this please also update the one in u-blox,ubxlib-device-gnss.yaml
    module-type:
        type: string
        default: "U_GNSS_MODULE_TYPE_ANY"
        description: "The GNSS module type, ONLY REQUIRED if the GNSS network is being added via a non-GNSS (for example cellular) device."
        enum:
            - "U_GNSS_MODULE_TYPE_M8"
            - "U_GNSS_MODULE_TYPE_M9"
            - "U_GNSS_MODULE_TYPE_M10"
            # Add any new module types here, before U_GNSS_MODULE_TYPE_ANY
            - "U_GNSS_MODULE_TYPE_ANY"
# devicePinPwr
    device-pin-pwr:
        type: int
        description: "Only relevant if the GNSS network is on a non-GNSS device, for example it is connected via or inside a (for example SARA-R510M8S) cellular module, and that intermediate module is controlling power to GNSS.  This is the pin OF THAT INTERMEDIATE MODULE and NOT of this MCU.  For instance, in the case of a cellular module, GPIO2 is cellular module pin 23 and hence 23 would be used here."
# devicePinDataReady
    device-pin-data-ready:
        type: int
        description: "Only relevant if the GNSS network is on a non-GNSS device, for example it is connected via or inside a (for example SARA-R510M8S) cellular module, and that intermediate module is connected to the Data Ready pin of GNSS.  This is the pin OF THAT INTERMEDIATE MODULE and NOT of this MCU.  For instance, in the case of a cellular module, GPIO3 is cellular module pin 24 and hence 24 would be used here."
```

## port/platform/zephyr/dts/bindings/u-blox,ubxlib-network-wifi.yaml
```yaml
# The device tree bindings that describe a ubxlib network
# configuration for a Wi-Fi module; basically uNetworkCfgWifi_t
# (see /common/network/api/u_network_config_wifi.h) but
# in .yaml form for Zephyr.

description: "ubxlib network configuration for Wi-Fi."

compatible: "u-blox,ubxlib-network-wifi"

properties:
    do-not-set-network-type:
       type: int
       default: 3
       description: "A hidden property: the application should _not_ set this, just allow it to be the default for a Wi-Fi network (matches U_NETWORK_TYPE_WIFI)."
    ssid:
        type: string
        description: "The SSID of the network to connect to; not required if credentials have previously been saved."
    authentication:
        type: int
        default: 1
        description: "The authentication mode. Values are (2) WPA/WPA2/WPA3-PSK, (6) WPA2/WPA3-PSK or (7) WPA3-PSK; not specified means open (1)."
    pass-phrase:
        type: string
        description: "The WPA/WPA2/WPA3 pass-phrase for the network being connected-to; not required if the authentication type is not specified (i.e. open)."
    host-name:
        type: string
        description: "The network host name of the Wi-Fi device; if not specified a default name combined of the module type and mac address will be used."
    mode:
        type: string
        default: "U_WIFI_MODE_STA"
        description: "The mode in which the Wi-Fi module should be started (station, access point, both or none)."
        enum:
            - "U_WIFI_MODE_STA"
            - "U_WIFI_MODE_AP"
            - "U_WIFI_MODE_STA_AP"
            - "U_WIFI_MODE_NONE"
    ap-ssid:
        type: string
        description: "The SSID of the access point."
    ap-authentication:
        type: int
        default: 1
        description: "The authentication mode of the access point. Values are (2) WPA/WPA2/WPA3-PSK, (6) WPA2/WPA3-PSK or (7) WPA3-PSK; not specified means open (1)."
    ap-pass-phrase:
        type: string
        description: "The WPA/WPA2/WPA3 pass-phrase for the access point; not required if the access point authentication type is not specified (i.e. open)."
    ap-ip-address:
        type: string
        description: "The IP address of the access point."
```

## port/platform/zephyr/runner/boards/ubx_evkninab4_nrf52833.conf
```kconfig
# docs at https://docs.zephyrproject.org/2.1.0/reference/kconfig/

# NRF52833 only has 128k bytes RAM and hence must use a reduced
# heap size
CONFIG_HEAP_MEM_POOL_SIZE=65536

# NRF52833 only has half a megabyte of flash, so to include all the test
# code we have to chuck something out; we're only testing GNSS here, so
# omit cellular and short range
CONFIG_UBXLIB_CELL=n
CONFIG_UBXLIB_SHORTRANGE=n
CONFIG_BT=n
```

## port/platform/zephyr/runner/sample.yaml
```yaml
sample:
  description: Ubxlib test application
  name: ubxlib
common:
    tags: introduction
    harness: console
    harness_config:
      type: one_line
      regex:
        - "Ubxlib (.*)"
tests:
  sample.basic.ubxlib:
    tags: introduction
```

## port/platform/zephyr/test_boards/boards/arm/sparkfun_asset_tracker_nrf52840/Kconfig
```kconfig
# Kconfig - SPARKFUN_ASSET_TRACKER_NRF52840 board configuration
#
# Copyright (c) 2020 u-blox AG
#
# SPDX-License-Identifier: Apache-2.0

config BOARD_ENABLE_DCDC
	bool "Enable DCDC mode"
	select SOC_DCDC_NRF52X
	default y
	depends on BOARD_SPARKFUN_ASSET_TRACKER_NRF52840
```

## west.yml
```yaml
manifest:
  remotes:
    - name: ThrowTheSwitch
      url-base: https://github.com/ThrowTheSwitch
  projects:
    - name: Unity
      remote: ThrowTheSwitch
      revision: v2.5.0
      path: modules/test/unity
```
