## port/platform/common/automation/west.yml
```yaml
# This is a kind of "master" manifest file that is employed during
# fetches to make Zephyr/west behave as we want. Specifically:
#
# 1. We need a single installation of Zephyr on a machine, to avoid
#    running out of disk/time with the N gigabyte download that
#    might otherwise result.
# 2. For a given Zephyr version, the compatible Git commit hashes of
#    the Zephyr modules that contain the HALs for the platform are
#    stored in that Zephyr version’s west.yml file: e.g. the
#    hal_stm32 module within Zephyr has no release tags/branches
#    associated with it, the only way to get the correct version of
#    that module is to fetch it using west, which reads the west.yml
#    file inside Zephyr.
# 3. We don’t want to install every platform [AKA module/lib/whatever]
#    Zephyr has ever supported (‘cos disk space/time) and the only
#    way to make west not install everything is to write stuff in a
#    west.yml file (e.g. name-allowlist etc.).
#
# The way to get west to do this is "topology 3", or the "forest topology"
# and this is the manifest file for that, representing the super-set
# of things we require from Zephyr; u_zephyr_package.py will copy it
# into the package installation directory where it will be used by
# "west update".

manifest:
  self:
    west-commands: scripts/west-commands.yml

  remotes:
    - name: zephyrproject-rtos
      url-base: https://github.com/zephyrproject-rtos

  projects:
    - name: zephyr
      remote: zephyrproject-rtos
      # u_zephyr_package.py will replace REVISION_REPLACE_ME with the intended version
      revision: REVISION_REPLACE_ME
      import:
        # By using name-allowlist we can clone only the modules that are
        # strictly needed by ubxlib
        name-allowlist:
          - cmsis
          - hal_stm32
          - mbedtls
          # Zephyr BLE GATT needs this on STM32
          - tinycrypt
```

## port/platform/esp-idf/mcu/esp32/runner/sdkconfig.defaults
```kconfig
# The few defaults that ubxlib cares about

# Note: the IDF_TARGET is not specified here: it will default to esp32
# and can be overridden by setting the environment variable IDF_TARGET

# This is sufficient that the user is left with 5 kbytes of
# main task stack free for themselves
CONFIG_ESP_MAIN_TASK_STACK_SIZE=8192

# UART 0 is used for tracing
CONFIG_ESP_DEBUG_STUBS_ENABLE=y
CONFIG_ESP_CONSOLE_UART_DEFAULT=y
CONFIG_ESP_CONSOLE_UART_NUM=0

# ubxlib needs no more than the NANO stuff
CONFIG_NEWLIB_NANO_FORMAT=y

# Needed to include PPP interface for integration into the bottom of LWIP
CONFIG_LWIP_PPP_SUPPORT=y
CONFIG_LWIP_PPP_PAP_SUPPORT=y
CONFIG_LWIP_PPP_CHAP_SUPPORT=y

# We set this to "n" as otherwise the PlatformIO builds
# fail because some AES functions are not brought-in
# to their pre-built ESP-IDF library; normally it would
# be set to "y"
CONFIG_MBEDTLS_HARDWARE_AES=n

# Set for testing purposes only
CONFIG_ESP_INT_WDT=y
CONFIG_ESP_INT_WDT_TIMEOUT_MS=300
CONFIG_ESP_INT_WDT_CHECK_CPU1=y
CONFIG_ESP_TASK_WDT=y
CONFIG_ESP_TASK_WDT_TIMEOUT_S=5
CONFIG_TASK_WDT_CHECK_IDLE_TASK_CPU0=y
CONFIG_TASK_WDT_CHECK_IDLE_TASK_CPU1=y
CONFIG_HEAP_TRACING_STANDALONE=y
CONFIG_HEAP_TRACING=y

# Uncomment these as required when debugging
#CONFIG_LWIP_PPP_DEBUG_ON=y
#CONFIG_LWIP_DEBUG=y
```

## port/platform/zephyr/Kconfig
```kconfig
config UBXLIB
        bool "u-blox ubxlib support"
        default n
        help
          Enable ubxlib for use with u-blox modules

if UBXLIB

if !NRF_SECURITY
config UBXLIB_CRYPTO
        bool "Crypto libraries required for some parts of ubxlib"
        default y
        select MBEDTLS
        select MBEDTLS_MAC_SHA256_ENABLED
        select MBEDTLS_CIPHER_AES_ENABLED
        help
          Bring in TLS libraries required by some parts of ubxlib
endif # !NRF_SECURITY

config UBXLIB_CELL
        bool "Cellular support"
        default y
        help
          This will enable cell API (must be selected at the moment)

config UBXLIB_GNSS
        bool "GNSS support"
        default y
        help
          This will enable GNSS API (must be selected at the moment)

menuconfig UBXLIB_SHORTRANGE
        bool "Short range support"
        default y
        help
          This will enable BLE and Wifi API (must be selected at the moment)

if UBXLIB_SHORTRANGE
config UBXLIB_OPEN_CPU_BLE
        bool "Enable ubxlib OpenCPU BLE components"
        default n
        depends on BT
        depends on BT_PERIPHERAL
        depends on BT_CENTRAL
        select BT_GATT_DYNAMIC_DB
        select BT_GATT_CLIENT
        help
          This will enable BLE SPS

menuconfig UBXLIB_EDM_STREAM_DEBUG
        bool "Enable logging of EDM stream events"
        default n
if UBXLIB_EDM_STREAM_DEBUG
config UBXLIB_EDM_STREAM_DEBUG_COLOR
        bool "Enable ANSI color coding for EDM debug"
        default y
config UBXLIB_EDM_STREAM_DEBUG_DUMP_DATA
        bool "Dump EDM data"
        default n
endif
endif

config UBXLIB_TEST
        bool "Compile the ubxlib tests"
        select TEST
        select IRQ_OFFLOAD # To be able to test semaphore from ISR
        select CPLUSPLUS # Unity requires cpp
        default n

endif # UBXLIB
```

## port/platform/zephyr/boards/cellular/boards/arm/sparkfun_asset_tracker_nrf52840/Kconfig.board
```kconfig
# Kconfig - SPARKFUN_ASSET_TRACKER_NRF52840 board configuration
#
# Copyright (c) 2020 u-blox AG
#
# SPDX-License-Identifier: Apache-2.0

config BOARD_SPARKFUN_ASSET_TRACKER_NRF52840
	bool "Sparkfun SPARKFUN_ASSET_TRACKER_NRF52840"
	depends on SOC_NRF52840_QIAA

# should be CKAA, but SOC file not yet available from Nordic Semiconductor
```

## port/platform/zephyr/boards/cellular/boards/arm/sparkfun_asset_tracker_nrf52840/Kconfig.defconfig
```kconfig
# Kconfig - SPARKFUN_ASSET_TRACKER_NRF52840 board configuration
#
# Copyright (c) 2020 u-blox AG
#
# SPDX-License-Identifier: Apache-2.0

if BOARD_SPARKFUN_ASSET_TRACKER_NRF52840

config BOARD
	default "sparkfun_asset_tracker_nrf52840"

if USB

config USB_NRFX
	default y

config USB_DEVICE_STACK
	default y

endif # USB

config IEEE802154_NRF5
	default y
	depends on IEEE802154

config BT_CTLR
	default BT

endif # BOARD_SPARKFUN_ASSET_TRACKER_NRF52840
```

## port/platform/zephyr/dts/bindings/u-blox,uart-ppp.yaml
```yaml
description: virtual ubxlib UART for PPP connections

compatible: "u-blox,uart-ppp"

include: [uart-controller.yaml]
```

## port/platform/zephyr/dts/bindings/u-blox,ubxlib-device-cellular.yaml
```yaml
# The device tree bindings for a ubxlib cellular device;
# basically uDeviceCfgCell_t (see /common/device/api/device.h)
# but in .yaml form for Zephyr.

description: "ubxlib cellular device configuration."

compatible: "u-blox,ubxlib-device-cellular"

properties:
# transportType
    transport-type:
        type: string
        required: true
        description: "The node label STRING for the transport that the cellular module is connected on, e.g. \"uart0\", no ampersand, no angle brackets and not an alias; make sure that &uart0, or whatever, is enabled in your device tree of course."
# baudRate for UART
    uart-baud-rate:
        type: int
        default: 115200
        description: "The baud-rate that the UART is running at, if not the default of 115200."
# moduleType, chosen from /cell/api/u_cell_module_type.h
    module-type:
        type: string
        default: "U_CELL_MODULE_TYPE_ANY"
        description: "The cellular module type."
        enum:
            - "U_CELL_MODULE_TYPE_SARA_U201"
            - "U_CELL_MODULE_TYPE_SARA_R410M_02B"
            - "U_CELL_MODULE_TYPE_SARA_R412M_02B"
            - "U_CELL_MODULE_TYPE_SARA_R412M_03B"
            - "U_CELL_MODULE_TYPE_SARA_R5"
            - "U_CELL_MODULE_TYPE_SARA_R410M_03B"
            - "U_CELL_MODULE_TYPE_SARA_R422"
            - "U_CELL_MODULE_TYPE_LARA_R6"
            - "U_CELL_MODULE_TYPE_LENA_R8"
            # Add any new module types here, before U_CELL_MODULE_TYPE_ANY
            - "U_CELL_MODULE_TYPE_ANY"
# pinEnablePower
    pin-enable-power:
        type: int
        description: "The GPIO output pin (an integer, counting from zero up through the GPIO banks) that enables power to the cellular module (e.g. through a relay or some such); not usually required."
# pinPwrOn
    pin-pwr-on:
        type: int
        description: "The GPIO output pin (an integer, counting from zero up through the GPIO banks) that is connected to the PWR_ON pin of the cellular module."
# pinVint
    pin-vint:
        type: int
        description: "The GPIO input pin (an integer, counting from zero up through the GPIO banks) that is connected to the VINT pin of the cellular module."
# pinDtrPowerSaving
    pin-dtr-power-saving:
        type: int
        description: "The GPIO output pin  (an integer, counting from zero up through the GPIO banksk) that is connected to the DTR pin of the cellular module because you intend to use the DTR pin to tell the module whether it can enter power-saving."
# Associated network configurations
    network:
        type: phandles
        description: "Network configuration(s) associated with this device; two may be needed, for instance, if using GNSS that is inside or connected-via a cellular device."
```

## port/platform/zephyr/dts/bindings/u-blox,ubxlib-device-gnss.yaml
```yaml
# The device tree bindings for a ubxlib GNSS device;
# basically uDeviceCfgGnss_t (see /common/device/api/device.h)
# but in .yaml form for Zephyr.

description: "ubxlib GNSS device configuration."

compatible: "u-blox,ubxlib-device-gnss"

properties:
# transportType
    transport-type:
        type: string
        required: true
        description: "The node label STRING for the transport that the GNSS module is connected on, e.g. \"i2c0\", no ampersand, no angle brackets; make sure that &i2c0, or whatever, is enabled in your device tree of course."
# baudRate for UART
    uart-baud-rate:
        type: int
        default: 9600
        description: "If transport is a UART, use this to specify the baud-rate that the UART is running at, if not the default of 9600."
# clockHertz for I2C
    i2c-clock-hertz:
        type: int
        default: 100000
        description: "If transport is I2C you may modify the clock rate here, in Hertz; if not specified the default of 100 kHz will be used."
# alreadyOpened for I2C
    i2c-already-open:
        type: boolean
        description: "If transport is I2C you may specify this to indicate that the application has already opened the I2C port and this code need do nothing (in which case i2c-clock will be ignored)."
# pinSelect for SPI
    spi-pin-select:
        type: int
        description: "The GPIO output pin (an integer, assuming 32 pins per GPIO bank) to use for SPI chip select; if you do not specify a pin then spi-index-select is used and if spi-index-select is not specified index 0 is used."
# indexSelect for SPI
    spi-index-select:
        type: int
        default: 0
        description: "The index of the CS pin from the chip select pins defined for the SPI controller being used by this device; ignored if spi-pin-select is specified."
# frequencyHertz for SPI
    spi-frequency-hertz:
        type: int
        default: 1000000
        description: "If transport is SPI you may modify the clock frequency here, in Hertz; if not specified the default 1 MHz will be used."
# mode for SPI
    spi-mode:
        type: int
        default: 0
        description: "The clock/data-read mode for SPI: 0 for CPOL 0/CPHA 0, 1 for CPOL 0/CPHA 1, 2 for CPOL 1/CPHA 0, 3 for CPOL 1/CPHA 1; if not specified 0 will be used."
# wordSizeBytes for SPI
    spi-word-size-bytes:
        type: int
        default: 1
        description: "The word size, in bytes for SPI; if not specified 1 will be used."
# lsbFirst for SPI
    spi-lsb-first:
        type: boolean
        description: "If using SPI, use this flag to indicate that the LSB should be sent first, else MSB will be sent first."
# startOffsetNanoseconds for SPI
    spi-start-offset-nanoseconds:
        type: int
        default: 0
        description: "The offset to apply after asserting CS and beginning an SPI transaction; if not specified there is no offset."
# stopOffsetNanoseconds for SPI
    spi-stop-offset-nanoseconds:
        type: int
        default: 0
        description: "The offset to apply after ending an SPI transaction before CS is deasserted; if not specified there is no offset."
# moduleType, chosen from /gnss/api/u_gnss_module_type.h
# IMPORTANT: if you update this please also update the one in u-blox,ubxlib-network-gnss.yaml
    module-type:
        type: string
        default: "U_GNSS_MODULE_TYPE_ANY"
        description: "The GNSS module type."
        enum:
            - "U_GNSS_MODULE_TYPE_M8"
            - "U_GNSS_MODULE_TYPE_M9"
            - "U_GNSS_MODULE_TYPE_M10"
            # Add any new module types here, before U_GNSS_MODULE_TYPE_ANY, and don't forget to update the one in u-blox,ubxlib-network-gnss.yaml also
            - "U_GNSS_MODULE_TYPE_ANY"
# pinEnablePower
    pin-enable-power:
        type: int
        description: "The GPIO output pin (an integer, assuming 32 pins per GPIO bank) that enables power to the GNSS device (e.g. through a relay or some such); not usually required."
# pinDataReady
    pin-data-ready:
        type: int
        description: "The GPIO output pin (an integer, assuming 32 pins per GPIO bank) that is connected to the Data Ready pin of the GNSS device; provided for future compatibility only, currently ignored."
# i2cAddress
    i2c-address:
        type: int
        default: 0x42
        description: "The I2C address of the GNSS device, required if the GNSS device is connected via I2C and its I2C address is not the default value of 0x42."
# indication that we're connected to UART 2 on the GNSS device
    gnss-uart2:
        type: boolean
        description: "Specify this flag if your UART connection is to the _second_ serial port of a GNSS device."
# Note: there is no associated network configuration for the GNSS case
```
